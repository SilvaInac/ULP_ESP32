/* Variable definitions for ESP32ULP linker
 * This file is generated automatically by esp32ulp_mapgen.py utility.
 */

PROVIDE ( ulp_entry = 0x50000000 );
PROVIDE ( ulp_exit = 0x50000064 );
PROVIDE ( ulp_io_number = 0x50000088 );
PROVIDE ( ulp_last_result = 0x50000084 );
PROVIDE ( ulp_Tpig_detect = 0x50000080 );
PROVIDE ( ulp_wake_up = 0x50000068 );
